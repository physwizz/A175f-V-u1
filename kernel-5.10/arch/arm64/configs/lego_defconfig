## kernel-5.10/arch/arm64/configs/lego_defconfig
```kconfig
CONFIG_SEC_PANEL_NOTIFIER_V2=m
CONFIG_USDM_PANEL_OLED_COMMON=m
CONFIG_USDM_PANEL_DB7F2010B=m
CONFIG_USDM_PANEL_DB7F2010B_90HZ=y
CONFIG_PDIC_S2MF301=m
CONFIG_S2MF301_PDIC_TRY_SNK=y
CONFIG_PDIC_SLSI_NON_MCU=m
CONFIG_PDIC_PD30=y
CONFIG_SUPPORT_USB_TYPEC_OPS=y
CONFIG_S2M_PDIC_MANUAL_RETRY=y
# CONFIG_SECURITY_DEFEX is not set
CONFIG_VIBRATOR_VIB_INFO=m
CONFIG_IIO=y
CONFIG_IIO_BUFFER=y
CONFIG_SHUB=m
CONFIG_INPUT_SEC_INPUT=m
CONFIG_INPUT_SEC_NOTIFIER=m
CONFIG_SEC_DEBUG_TSP_LOG=m
CONFIG_TOUCHSCREEN_DUMP_MODE=m
CONFIG_SEC_INPUT_HEADER=y
# CONFIG_INPUT_SEC_SECURE_TOUCH is not set
# CONFIG_INPUT_SEC_TRUSTED_TOUCH is not set
CONFIG_INPUT_TOUCHSCREEN_TCLMV2=m
# CONFIG_SEC_INPUT_MULTI_DEVICE is not set
# CONFIG_SEC_INPUT_RAWDATA is not set
CONFIG_SEC_NFC_LOGGER=y
# CONFIG_NFC_LOGGER_LOWMEM is not set
# CONFIG_SECURITY_DSMS is not set
CONFIG_TOUCHSCREEN_ZINITIX_ZT7650M=m
CONFIG_DEV_RIL_BRIDGE=m
CONFIG_USDM_PANEL_S6E8FC3=m
CONFIG_SEC_VIBRATOR=m
CONFIG_SUPPORT_DROPDUMP=m
CONFIG_MUIC_NOTIFIER=m
CONFIG_VBUS_NOTIFIER=m
CONFIG_HICCUP_CC_DISABLE=y
CONFIG_HICCUP_CHARGER=y
CONFIG_MUIC_COMMON_SYSFS=y
CONFIG_MUIC_AFC_RETRY=y
CONFIG_MUIC_HV=y
CONFIG_MUIC_SUPPORT_PDIC=y
CONFIG_MUIC_USE_MODULE_PARAM=y
CONFIG_USE_MUIC=y
CONFIG_NGKSM=m
CONFIG_NGKPAD=m
CONFIG_NGKSM_MTK=y
CONFIG_SEC_STI=y
CONFIG_USB_NOTIFY_LAYER=m
CONFIG_USB_DEBUG_DETAILED_LOG=y
CONFIG_USB_EXTERNAL_NOTIFY=y
CONFIG_USB_HMT_SAMSUNG_INPUT=y
CONFIG_USB_HOST_NOTIFY=y
CONFIG_USB_HOST_SAMSUNG_FEATURE=y
CONFIG_USB_HW_PARAM=y
CONFIG_USB_INTERFACE_LPM_LIST=y
CONFIG_USB_NOTIFY_PROC_LOG=y
CONFIG_USB_USING_ADVANCED_USBLOG=y
# CONFIG_KG_DRV is not set
CONFIG_ZRAM=m
CONFIG_SEC_INPUT_BOOSTER=m
# CONFIG_SEC_INPUT_BOOSTER_MODE is not set
CONFIG_SEC_INPUT_BOOSTER_MTK=y
CONFIG_SEC_INPUT_BOOSTER_HANDLER=y
CONFIG_SB_CORE=m
CONFIG_SB_PQUEUE=y
CONFIG_SB_NOTIFY=y
CONFIG_SB_SYSFS=y
CONFIG_SB_VOTE=y
CONFIG_ANDROID_SWITCH=m
# CONFIG_ANDROID_SWITCH_GPIO is not set
CONFIG_LSI_IFPMIC=y
CONFIG_CHARGER_S2MF301=m
CONFIG_PM_S2MF301=m
CONFIG_SHIPMODE_BY_VBAT=y
CONFIG_HDM=m
CONFIG_HDM_MTK=y
CONFIG_USB_TYPEC_MANAGER_NOTIFIER=m
CONFIG_IF_CB_MANAGER=m
CONFIG_SENSORS_FINGERPRINT=m
CONFIG_MUIC_PLATFORM=m
CONFIG_HV_MUIC_VOLTAGE_CTRL=y
CONFIG_MUIC_SUPPORT_POWERMETER=y
CONFIG_MUIC_SUPPORT_PRSWAP=y
CONFIG_SEC_ABC_SPEC_TYPE1=m
CONFIG_DRM_PANEL_MCD_COMMON=m
# CONFIG_DRM_PANEL_SAMSUNG_COMMON is not set
CONFIG_USDM_PANEL_JSON=y
CONFIG_PDIC_NOTIFIER=m
CONFIG_PDIC_USE_MODULE_PARAM=y
CONFIG_SHUB_MODULE=y
CONFIG_SHUB_AP_STATUS_CMD=y
CONFIG_SHUB_MTK=y
CONFIG_SEC_ABC=m
CONFIG_SEC_ABC_HUB=m
CONFIG_SEC_ABC_COMMON=m
CONFIG_SEC_ABC_HUB_CORE=m
CONFIG_SEC_ABC_HUB_BOOTC=m
CONFIG_SEC_ABC_MOTTO=m
CONFIG_USB_NOTIFIER=m
CONFIG_I2C_GPIO=m
CONFIG_FUELGAUGE_S2MF301=m
CONFIG_UI_SOC_PROLONGING=y
CONFIG_SEC_PM_THERMISTOR=m
CONFIG_BATTERY_AUTH_DS28E30=m
CONFIG_MFD_S2MF301=m
CONFIG_CHARGER_SM5461=m
CONFIG_MST_LDO=m
CONFIG_MST_ARCH_MTK=y
CONFIG_MST_TEEGRIS=y
CONFIG_MST_DUMMY_DRV=y
CONFIG_BATTERY_AUTH_SLE956681=m
CONFIG_SENSORS_EC6XX=m
CONFIG_SENSORS_FINGERPRINT_MODULE=y
CONFIG_FINGERPRINT_SECURE=y
CONFIG_SENSORS_FINGERPRINT_MTK=y
CONFIG_REGULATOR_FIXED_VOLTAGE=y
CONFIG_MUIC_S2MF301=m
CONFIG_HV_MUIC_S2MF301_AFC=y
CONFIG_MUIC_S2MF301_RID=y
CONFIG_TOP_S2MF301=y
CONFIG_REGULATOR_S2MPB03=m
CONFIG_DIRECT_CHARGING=m
CONFIG_TOUCHSCREEN_FTS_FT3519=m
CONFIG_STAR_K250A_LEGO=m
CONFIG_SEC_SNVM_PLATFORM_DRV=y
CONFIG_SEC_SNVM_I2C_CLOCK_CONTROL=y
CONFIG_SEC_SNVM_WAKELOCK_METHOD=2
# CONFIG_STAR_MEMORY_LEAK is not set
CONFIG_SENSORS_SX9385=m
CONFIG_SENSORS_SX9385_SUB=m
# CONFIG_SENSORS_SX9385_SUB2 is not set
# CONFIG_SENSORS_SX9385_WIFI is not set
CONFIG_SENSORS_GRIP_FAILURE_DEBUG=y
CONFIG_SENSORS_IRQ_PROCESSING_DELAY=y
CONFIG_MULTI_CHANNEL=y
CONFIG_DC_VIBRATOR=m
# CONFIG_MTK_VIBRATOR is not set
CONFIG_SAMSUNG_NFC=m
CONFIG_SEC_MX_NFC=y
CONFIG_MTK_NFC_CLKBUF_ENABLE=y
CONFIG_MTK_CLKBUF_NFC=y
# CONFIG_SEC_NFC_EINT_EXYNOS is not set
CONFIG_SEC_NFC_WAKELOCK_METHOD=2
# CONFIG_SEC_NFC_DUPLICATED_IRQ_WQ is not set
# CONFIG_SEC_NFC_WAIT_FOR_DISABLE_COMBO_RESET_IRQ is not set
# CONFIG_SEC_NFC_TEST_ON_PROBE is not set
# CONFIG_SEC_NFC_PVDDOFF_ONSHUTDOWN is not set
# CONFIG_ESE_P3_LSI is not set
# CONFIG_ESE_COLDRESET is not set
# CONFIG_ESE_USE_REGULATOR is not set
# CONFIG_MAKE_NODE_USING_PLATFORM_DEVICE is not set
CONFIG_CAM_BUCKBOOST=m
CONFIG_CAM_BB_MAX77816=m
CONFIG_BATTERY_SAMSUNG=m
CONFIG_SEC_PD=m
CONFIG_BATTERY_GKI=y
CONFIG_BATTERY_AGE_FORECAST=y
CONFIG_BATTERY_CISD=y
CONFIG_AFC_CHARGER_MODE=y
CONFIG_BATTERY_AUTH_EUR_DET_GPIO_SUPPORT=y
CONFIG_BATTERY_LOGGING=y
CONFIG_ENABLE_FULL_BY_SOC=y
CONFIG_STEP_CHARGING=y
CONFIG_SUPPORT_HV_CTRL=y
```

## kernel-5.10/drivers/battery/battery_auth/ds28e30/Kconfig
```kconfig
#
# ADI Authenticate IC
#

config BATTERY_AUTH_DS28E30
	tristate "ADI Authenticate IC"
	default n
	help
	  Say Y to ADI Authenticate IC.

config A36XQ_AUTH_WA
	bool "A36XQ_AUTH_WA"
	default n
	help
	  Say Y here to enable
	  This feature is used for A36xq model only
	  It will be used as wa for A36xq SWI communication improvement
```

## kernel-5.10/drivers/knox/kg/Kconfig
```kconfig
config KG_DRV
	tristate "KG driver"
	depends on !SEC_VTS_TEST
	depends on !SEC_KUNIT
	depends on !ARCH_QTI_VM
	default n
	help
	  KG driver

config KG_LOG
	tristate "KG log"
	depends on KG_DRV
	default y
	help
	  KG log

config KG_RESOURCE_CPU
	tristate "KG resource cpu"
	depends on KG_DRV
	default y
	help
	  KG resource cpu

config KG_RESOURCE_CPU_MAXFREQ_LIMIT
	int "percentage of maxfreq limit"
	depends on KG_RESOURCE_CPU
	default 25
	range 0 100
	help
	  0 means limit to minfreq. 100 means no limit.

# CONFIG_KG_DRV_TEST should be disabled at user build
config KG_DRV_TEST
	tristate "KG driver test"
	depends on KG_DRV
	default n
	help
	  KG drv test
```

## kernel-5.10/drivers/misc/mediatek/cam_buckboost/Kconfig
```kconfig
config CAM_BUCKBOOST
	tristate "camera buckboost"
	help
	  This is config for camera buck boost

config CAM_BB_MAX77816
	tristate "camera buckboost driver(MAX77816)"
	depends on CAM_BUCKBOOST
	help
	  This module is the Buckboost driver of the camera.
	  buckboost is a driver for camera power.
	  It is operated using MAX77816.
	  you can select whether to use each project and enable config in the general variant.
```
